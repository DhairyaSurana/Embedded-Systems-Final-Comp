// These arguments were used when this file was generated. They will be automatically applied on subsequent loads 
// via the GUI or CLI invocations. Run CLI with '--help' for additional information on how to override these arguments.
// @cliArgs --board "/ti/boards/CC3220SF_LAUNCHXL" --product "simplelink_cc32xx_sdk@3.30.01.02"
// @versions {"data":"2019103101","timestamp":"2019103101","tool":"1.3.1030","templates":"2019103101"}

var RTOS = scripting.addModule("/ti/drivers/RTOS");
var ADC = scripting.addModule("/ti/drivers/ADC");
var ADC1 = ADC.addInstance();
var Board = scripting.addModule("/ti/drivers/Board");
var Timer = scripting.addModule("/ti/drivers/Timer");
var Timer1 = Timer.addInstance();
var Power = scripting.addModule("/ti/drivers/Power");
var Timer2 = Timer.addInstance();
var GPIO = scripting.addModule("/ti/drivers/GPIO");
var GPIO1 = GPIO.addInstance();
var GPIO2 = GPIO.addInstance();
var GPIO3 = GPIO.addInstance();
var GPIO4 = GPIO.addInstance();
var GPIO5 = GPIO.addInstance();
var GPIO6 = GPIO.addInstance();
var GPIO7 = GPIO.addInstance();
var GPIO8 = GPIO.addInstance();
var UART = scripting.addModule("/ti/drivers/UART");
var UART1 = UART.addInstance();
var GPIO9 = GPIO.addInstance();
var GPIO10 = GPIO.addInstance();
var GPIO11 = GPIO.addInstance();
var GPIO12 = GPIO.addInstance();
var GPIO13 = GPIO.addInstance();
var GPIO14 = GPIO.addInstance();
var GPIO15 = GPIO.addInstance();
var SPI = scripting.addModule("/ti/drivers/SPI");
var SPI1 = SPI.addInstance();
// Name - The C/C++ identifier used in applications as the index parameter passed to ADC runtime APIs
ADC1.$name = "Board_ADC0";
// Name
ADC1.adc.$name = "MyADC1";
// Assign pin
ADC1.adc.adcPin.$assign = "boosterpack.2"; // P58*
var DriverLib = scripting.addModule("/ti/devices/DriverLib", {}, false);
// Name - The C/C++ identifier used in applications as the index parameter passed to Timer runtime APIs
Timer1.$name = "Board_TIMER0";
// Timer Type
Timer1.timerType = "32 Bits";
// Name
Timer1.timer.$name = "MyTimer1";
// Use Peripheral
Timer1.timer.$assign = "Timer0";
// Name
Power.parkPins.$name = "ti_drivers_power_PowerCC32XXPins0";
// Name - The C/C++ identifier used in applications as the index parameter passed to Timer runtime APIs
Timer2.$name = "Board_TIMER1";
// Timer Type
Timer2.timerType = "32 Bits";
// Name
Timer2.timer.$name = "MyTimer1";
// Use Peripheral
Timer2.timer.$assign = "Timer1";
// Name - The C/C++ identifier used in applications as the index parameter passed to GPIO runtime APIs
GPIO1.$name = "Board_GPIO0";
// Mode - Select the GPIO mode
GPIO1.mode = "Output";
// Assign pin
GPIO1.gpioPin.$assign = "boosterpack.30"; // P50
// Name - The C/C++ identifier used in applications as the index parameter passed to GPIO runtime APIs
GPIO2.$name = "Board_GPIO1";
// Mode - Select the GPIO mode
GPIO2.mode = "Output";
// Assign pin
GPIO2.gpioPin.$assign = "boosterpack.24"; // P60
// Name - The C/C++ identifier used in applications as the index parameter passed to GPIO runtime APIs
GPIO3.$name = "Board_GPIO2";
// Mode - Select the GPIO mode
GPIO3.mode = "Output";
// Assign pin
GPIO3.gpioPin.$assign = "boosterpack.5"; // P61
// Name - The C/C++ identifier used in applications as the index parameter passed to GPIO runtime APIs
GPIO4.$name = "Board_GPIO3";
// Mode - Select the GPIO mode
GPIO4.mode = "Output";
// Assign pin (ignoring conflicts)
GPIO4.gpioPin.$assignAllowConflicts = "boosterpack.8"; // P62
// Name - The C/C++ identifier used in applications as the index parameter passed to GPIO runtime APIs
GPIO5.$name = "Board_GPIO4";
// Mode - Select the GPIO mode
GPIO5.mode = "Output";
// Assign pin
GPIO5.gpioPin.$assign = "boosterpack.27"; // P63
// Name - The C/C++ identifier used in applications as the index parameter passed to GPIO runtime APIs
GPIO6.$name = "Board_GPIO5";
// Mode - Select the GPIO mode
GPIO6.mode = "Output";
// Assign pin
GPIO6.gpioPin.$assign = "boosterpack.4"; // P03
// Name - The C/C++ identifier used in applications as the index parameter passed to GPIO runtime APIs
GPIO7.$name = "Board_GPIO6";
// Mode - Select the GPIO mode
GPIO7.mode = "Output";
// Assign pin
GPIO7.gpioPin.$assign = "boosterpack.7"; // P05
// Name - The C/C++ identifier used in applications as the index parameter passed to GPIO runtime APIs
GPIO8.$name = "Board_GPIO7";
// Mode - Select the GPIO mode
GPIO8.mode = "Output";
// Assign pin
GPIO8.gpioPin.$assign = "boosterpack.14"; // P06
// Use Hardware - Select the hardware to use, or 'None' to use available header pins
UART1.$hardware = system.deviceData.board.components.XDS110UART;
// Name - The C/C++ identifier used in applications as the index parameter passed to UART runtime APIs
UART1.$name = "Board_UART0";
// Name
UART1.uart.$name = "MyUART1";
// Mode - Select the GPIO mode
GPIO9.mode = "Output";
// Name - The C/C++ identifier used in applications as the index parameter passed to GPIO runtime APIs
GPIO9.$name = "Board_GPIO8_TRIG";
// Assign pin
GPIO9.gpioPin.$assign = "boosterpack.19"; // P18
// Interrupt Trigger - Specifies when or if interrupts are triggered
GPIO10.interruptTrigger = "Both Edges";
// Mode - Select the GPIO mode
GPIO10.mode = "Dynamic";
// Name - The C/C++ identifier used in applications as the index parameter passed to GPIO runtime APIs
GPIO10.$name = "Board_GPIO9_Echo";
// Assign pin
GPIO10.gpioPin.$assign = "boosterpack.13"; // P21
// Name - The C/C++ identifier used in applications as the index parameter passed to GPIO runtime APIs
GPIO11.$name = "CONFIG_GPIO_BUTTON_0";
// Use Hardware - Select the hardware to use, or 'None' to use available header pins
GPIO11.$hardware = system.deviceData.board.components.SW2;
// Name - The C/C++ identifier used in applications as the index parameter passed to GPIO runtime APIs
GPIO12.$name = "CONFIG_GPIO_BUTTON_1";
// Use Hardware - Select the hardware to use, or 'None' to use available header pins
GPIO12.$hardware = system.deviceData.board.components.SW3;
// Name - The C/C++ identifier used in applications as the index parameter passed to GPIO runtime APIs
GPIO13.$name = "CONFIG_GPIO_LED_0";
// Use Hardware - Select the hardware to use, or 'None' to use available header pins
GPIO13.$hardware = system.deviceData.board.components.LED_RED;
// Output Strength - Specifies the output strength
GPIO13.outputStrength = "High";
// Assign pin
GPIO13.gpioPin.$assign = "boosterpack.29"; // P64
// Name - The C/C++ identifier used in applications as the index parameter passed to GPIO runtime APIs
GPIO14.$name = "CONFIG_GPIO_LED_1";
// Use Hardware - Select the hardware to use, or 'None' to use available header pins
GPIO14.$hardware = system.deviceData.board.components.LED_YELLOW;
// Name - The C/C++ identifier used in applications as the index parameter passed to GPIO runtime APIs
GPIO15.$name = "CONFIG_GPIO_LED_2";
// Use Hardware - Select the hardware to use, or 'None' to use available header pins
GPIO15.$hardware = system.deviceData.board.components.LED_GREEN;
var DMA = scripting.addModule("/ti/drivers/DMA", {}, false);
// Name - The C/C++ identifier used in applications as the index parameter passed to SPI runtime APIs
SPI1.$name = "CONFIG_SPI_0";
// Mode - In three pin mode the SS signal is not used.
SPI1.mode = "Four Pin SS Active Low";
// Name
SPI1.spi.$name = "MySPI1";
// Assign pin
SPI1.spi.misoPin.$assign = "boosterpack.28"; // P53
// Suggest solution
ADC1.adc.$suggestSolution = "ADC0";
// Suggest solution
UART1.uart.$suggestSolution = "UART0";
// Suggest solution
UART1.uart.txPin.$suggestSolution = "55";
// Suggest solution
UART1.uart.rxPin.$suggestSolution = "57";
// Suggest solution
GPIO11.gpioPin.$suggestSolution = "4";
// Suggest solution
GPIO12.gpioPin.$suggestSolution = "15";
// Suggest solution
GPIO14.gpioPin.$suggestSolution = "1";
// Suggest solution
GPIO15.gpioPin.$suggestSolution = "2";
// Suggest solution
SPI1.spi.$suggestSolution = "SPI0";
// Suggest solution
SPI1.spi.sclkPin.$suggestSolution = "45";
// Suggest solution
SPI1.spi.mosiPin.$suggestSolution = "7";
// Suggest solution
SPI1.spi.ssPin.$suggestSolution = "8";
// Suggest solution
SPI1.spi.dmaRxChannel.$suggestSolution = "UDMA_CH30";
// Suggest solution
SPI1.spi.dmaTxChannel.$suggestSolution = "UDMA_CH31";
